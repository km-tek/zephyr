## boards/arm/kmt_dev_lpc55s28jbd64/Kconfig.board
```kconfig
# kmt dev lpc55S28jbd64 board

# Copyright (c) 2021 Kien Minh Co.,Ltd
# SPDX-License-Identifier: Apache-2.0

config BOARD_KMT_DEV_LPC55S28JBD64
	bool "BOARD_KMT_DEV_LPC55S28JBD64"
	depends on SOC_SERIES_LPC55XXX
	select SOC_PART_NUMBER_LPC55S28JBD64
```

## boards/arm/kmt_dev_lpc55s28jbd64/Kconfig.defconfig
```kconfig
# kmt dev lpc55S28jbd64 board

# Copyright (c) 2021 Kien Minh Co.,Ltd
# SPDX-License-Identifier: Apache-2.0

if BOARD_KMT_DEV_LPC55S28JBD64

config BOARD
	default "kmt_dev_lpc55s28jbd64"

if PINMUX_MCUX_LPC

config PINMUX_MCUX_LPC_PORT0
	default y

config PINMUX_MCUX_LPC_PORT1
	default y

endif # PINMUX_MCUX_LPC

if GPIO_MCUX_LPC

config GPIO_MCUX_LPC_PORT0
	default y

config GPIO_MCUX_LPC_PORT1
	default y

endif # GPIO_MCUX_LPC

config SPI_8
	default y
	depends on SPI

config FXOS8700_DRDY_INT1
	default y
	depends on FXOS8700_TRIGGER

# For the secure version of the board the firmware is linked at the beginning
# of the flash, or into the code-partition defined in DT if it is intended to
# be loaded by MCUboot. If the secure firmware is to be combined with a non-
# secure image (TRUSTED_EXECUTION_SECURE=y), the secure FW image shall always
# be restricted to the size of its code partition.
# For the non-secure version of the board, the firmware
# must be linked into the code-partition (non-secure) defined in DT, regardless.
# Apply this configuration below by setting the Kconfig symbols used by
# the linker according to the information extracted from DT partitions.

# Workaround for not being able to have commas in macro arguments
DT_CHOSEN_Z_CODE_PARTITION := zephyr,code-partition

config FLASH_LOAD_SIZE
	default $(dt_chosen_reg_size_hex,$(DT_CHOSEN_Z_CODE_PARTITION))
	depends on BOARD_KMT_DEV_LPC55S28JBD64 && TRUSTED_EXECUTION_SECURE

endif # BOARD_KMT_DEV_LPC55S28JBD64

if DMA_MCUX_LPC

# Memory from the heap pool is used to allocate DMA descriptors for
# channels that use multiple blocks for a DMA transfer.
# Adjust HEAP_MEM_POOL_SIZE in case you need more memory.
config HEAP_MEM_POOL_SIZE
	default 4096

endif # DMA_MCUX_LPC
```

## boards/arm/kmt_dev_nrf9160/Kconfig.board
```kconfig
# Kien Minh nRF9160 Develop configuration

# Copyright (c) 2018-2020 Nordic Semiconductor ASA
# Copyright (c) 2021 Kien Minh Co.,Ltd
# SPDX-License-Identifier: Apache-2.0

if SOC_NRF9160_SICA

config BOARD_KMT_DEV_NRF9160
	bool "Kien Minh nRF9160 Develop"

config BOARD_KMT_DEV_NRF9160NS
	bool "Kien Minh nRF9160 Develop non-secure"

endif # SOC_NRF9160_SICA
```

## boards/arm/nrf52840_kmt/Kconfig.board
```kconfig
# Kien Minh nRF52840 board configuration

# Copyright (c) 2021 Kien Minh Co.,Ltd
# SPDX-License-Identifier: Apache-2.0

config BOARD_NRF52840_KMT
	bool "NRF52840 KMT"
	depends on SOC_NRF52840_QIAA
```

## boards/arm/nrf52840_kmt/Kconfig.defconfig
```kconfig
# Kien Minh nRF52840 board configuration

# Copyright (c) 2021 Kien Minh Co.,Ltd
# SPDX-License-Identifier: Apache-2.0

if BOARD_NRF52840_KMT

config BOARD
	default "nrf52840_kmt"

if USB

config USB_NRFX
	default y

config USB_DEVICE_STACK
	default y

endif # USB

config BT_CTLR
	default BT

endif # BOARD_NRF52840_KMT
```

## boards/arm/nrf9160_kmt/Kconfig.board
```kconfig
# Circuit Dojo nRF9160 Feather configuration

# Copyright (c) 2018-2020 Nordic Semiconductor ASA
# Copyright (c) 2021 Kien Minh Co.,Ltd
# SPDX-License-Identifier: Apache-2.0

if SOC_NRF9160_SICA

config BOARD_NRF9160_KMT
	bool "Kien Minh nRF9160"

config BOARD_NRF9160NS_KMTNS
	bool "Kien Minh nRF9160 non-secure"

endif # SOC_NRF9160_SICA
```
